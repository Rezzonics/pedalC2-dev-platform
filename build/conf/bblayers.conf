## build/conf/bblayers.conf
```bitbake
# POKY_BBLAYERS_CONF_VERSION is increased each time build/conf/bblayers.conf
# changes incompatibly
POKY_BBLAYERS_CONF_VERSION = "2"

BBPATH = "${TOPDIR}"
BBFILES ?= ""

#   ${TOPDIR}/workspace 
#  ${TOPDIR}/../../yocto-odroid/meta-openembedded/meta-ruby 
BBLAYERS ?= " \
  ${TOPDIR}/../../yocto-odroid/meta \
  ${TOPDIR}/../../yocto-odroid/meta-poky \
  ${TOPDIR}/../../yocto-odroid/meta-yocto-bsp \
  ${TOPDIR}/../../yocto-odroid/meta-openembedded/meta-oe \
  ${TOPDIR}/../../yocto-odroid/meta-openembedded/meta-multimedia \
  ${TOPDIR}/../../yocto-odroid/meta-openembedded/meta-networking \
  ${TOPDIR}/../../yocto-odroid/meta-openembedded/meta-python \
  ${TOPDIR}/../../yocto-odroid/meta-openembedded/meta-gnome \
  ${TOPDIR}/../../yocto-odroid/meta-openembedded/meta-xfce \
  ${TOPDIR}/../../yocto-odroid/meta-openembedded/meta-filesystems \
  ${TOPDIR}/../../yocto-odroid/meta-openembedded/meta-cloud-services \
  ${TOPDIR}/../../yocto-odroid/meta-openembedded/meta-virtualization \
  ${TOPDIR}/../../yocto-odroid/meta-openembedded/meta-webserver \
  ${TOPDIR}/../../yocto-odroid/meta-openembedded/meta-cloud-services/meta-openstack \
  ${TOPDIR}/../../yocto-odroid/meta-qt5 \
  ${TOPDIR}/../../yocto-odroid/meta-musicians \
  ${TOPDIR}/../meta-meson \
  ${TOPDIR}/../meta-pedalpi \
  ${TOPDIR}/../meta-odroidc2-pedalpi \
  ${TOPDIR}/../meta-common \
  "
```
